/* **************************************************************************
 * SYSTEM.c
 * ==========================================================================
 * *********************************************************************** */

/**
 * \file
 * \brief	SISTEMA LECCIÓN 5
 *
 *
 *
 */

/* **************************************************************************
 * DECLARACIONES
 ************************************************************************* */

#include <STM32F042_VECT_.h>
#include "CORTEXM_TYPES.h"
#include "STM32F042_REGS_.h"

#include "RELOJ_.h"

#include "ANALOG_.h"
#include "BUZZER_.h"
#include "CAN_.h"
#include "I2CS_.h"
#include "LED_.h"
#include "LEDD_.h"
#include "SERIE_.h"
#include "SWITCH_.h"

#include "SYSTEM.h"

/* **************************************************************************
 * DEFINICIONES Y CONSTANTES
 ************************************************************************* */

#define		DEBUGPIN		/* COmentar para quitar depuración por pin */

#define 	RITHM	(1000)			/* 1kHz para SysTick */

/* **************************************************************************
 * VARIABLES
 ************************************************************************* */

static uint32_t tiempoon;

static uint32_t tiempo1;
static uint32_t tiempo2;

/* ##########################################################################
 * ##########################################################################
 * ########        AUXILIARES        ########################################
 * ##########################################################################
 * ####################################################################### */

/* **************************************************************************
 * REINICIAR EL PROCESADOR
 * --------------------------------------------------------------------------
 * *********************************************************************** */

/* **************************************************************************
 * ATENDER AL WATCHDOG
 * --------------------------------------------------------------------------
 * *********************************************************************** */

/* **************************************************************************
 * SELECCIONAR UN MODO DE BAJO CONSUMO
 * --------------------------------------------------------------------------
 * *********************************************************************** */


/* ##########################################################################
 * ##########################################################################
 * ########        SISTEMA        ###########################################
 * ##########################################################################
 * ####################################################################### */

/* **************************************************************************
 * INICIALIZACIÓN DEL SISTEMA
 * --------------------------------------------------------------------------
 * *********************************************************************** */

uint32_t SYSTEM_Ini(uint32_t prmi)
{

	/* --- INICIALIZACIÓN DE RELOJ --------------------------------------- */

	RELOJ_Ini(0);

	/* --- ACTIVAR TODOS LOS PUERTOS ------------------------------------- */

	*RCC_AHBENR |= 0x007E0000;  /* Activa reloj hacia los puertos E/S */

	/* --- INICIALIZACIONES: MÓDULOS ------------------------------------- */

	ANALOG_Ini(0);
	BUZZER_Ini(0);
	CAN_Ini(0);
	I2CS_Ini(0);
    LEDD_Ini(0);
    LED_Ini(0);
    SERIE_Ini(0);
    SWITCH_Ini(0);

    /* --- INICIALIZACIONES: PUERTOS NO EMPLEADOS ------------------------ */

    // Pendiente. Se hacen las pruebas sin ello

    /* ---- INICIALIZACIONES: TEMPORIZADOR DE SISTEMA -------------------- */

    *STK_RVR = (RELOJ_GetFreq()/RITHM) - 1;         /* Top value */

    *STK_CSR = 0x0005;              /* Enable & select processor clock */
    *STK_CSR |= 0x0002;            /* Enable interrupt request */

    *SHPR3 &= ~0x33000000;         /* Low priority (high value) */
    *SHPR3 |=  0xCC000000;         /* Low priority (high value) */

    /* --- ESPERA A ESTABILIZACIÓN --------------------------------------- */

    //Algunos módulos pueden requierir un tiempo para estabilziarse

    /* --- FINAL DE INICIALIZACIONES ------------------------------------- */

    return(0);

}

/* **************************************************************************
 * ATENCIÓN A LA INTERRUPCIÓN DEL TEMPORIZADOR DE SISTEMA
 * --------------------------------------------------------------------------
 * *********************************************************************** */

void SysTick_Handler()
{

	/* --- ACTUALIZACIÓN DE LOS MÓDULOS @ 1kHz --------------------------- */

	ANALOG_Per();
	BUZZER_Per();
	CAN_Per();
	I2CS_Per();
	LEDD_Per();
	LED_Per();
	SERIE_Per();
	SWITCH_Per();

	/* --- TEMPORIZADOR DE TIEMPO ACTIVO --------------------------------- */

	++tiempoon;

	/* --- TEMPORIZADORES DE APLICACIÓN ---------------------------------- */

	if(tiempo1 != 0)
	{
		--tiempo1;
	}
	if(tiempo2 != 0)
	{
		--tiempo2;
	}

	/* --- FINAL DE LA INTERRUPCIÓN -------------------------------------- */

}

/* ##########################################################################
 * ##########################################################################
 * ########        APLICACIÓN        ########################################
 * ##########################################################################
 * ####################################################################### */

/* **************************************************************************
 * LEER EL TIEMPO ACTIVO
 * --------------------------------------------------------------------------
 * *********************************************************************** */

uint32_t SYSTEM_GetTiempoON()
{
    return(tiempoon);
}


/* **************************************************************************
 * LEER UN TEMPORIZADOR DE SISTEMA
 * --------------------------------------------------------------------------
 * *********************************************************************** */

uint32_t SISTEM_GetTimer(uint32_t timer)
{
    switch(timer)
    {
    case SYSTEM_ID_TIMER1:
    	return(tiempo1);
    	break;

    case SYSTEM_ID_TIMER2:
    	return(tiempo2);
    	break;

    default:
    	return(0xFFFFFFFF);
    	break;
    }
}


/* **************************************************************************
 * ESCRIBIR UN TEMPORIZADOR DE SISTEMA
 * --------------------------------------------------------------------------
 * *********************************************************************** */

uint32_t SISTEM_SetTimer(uint32_t timer, uint32_t time)
{
    switch(timer)
    {
    case SYSTEM_ID_TIMER1:
    	tiempo1 = time;
    	break;

    case SYSTEM_ID_TIMER2:
    	tiempo2 = time;
    	break;

    default:
    	time = 0xFFFFFFFF;
    	break;
    }
    return(time);
}


/* ##########################################################################
 * ##########################################################################
 * ####################################################################### */

/**
 * \file
 *
 * # DESCRIPCIÓN
 *
 * Este módulo implementa "el corazón" del sistema. Debe llamarse antes de
 * copmenzar a ejecutar cualqjuier aplicación.
 *
 * Inicializar recursos comunes, llamar a las funciones de inicialización de
 * los módulos que forman el sistema, activar el temporizador de sistema con
 * interrupción a un ritmo de 1kHz para atender a las llamadas periódicas de
 * los módulos son sus tareas más importantes.
 *
 *
 */
